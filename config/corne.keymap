#include "../miryoku/custom_config.h"
#include "../miryoku/mapping/42/corne.h"
#include "../miryoku/miryoku.h"

/* Route QWERTY modifier-taps by hand. */
#undef U_MT
#define U_MT(MOD, TAP) U_HT_##TAP MOD TAP

#define U_HT_A   &hml
#define U_HT_S   &hml
#define U_HT_D   &hml
#define U_HT_F   &hml
#define U_HT_J   &hmr
#define U_HT_K   &hmr
#define U_HT_L   &hmr
#define U_HT_SQT &hmr
#define U_HT_X   &u_mt
#define U_HT_DOT &u_mt

#include "../miryoku/miryoku.dtsi"

/ {
    behaviors {
        hml: home_row_mod_left {
            compatible = "zmk,behavior-hold-tap";
            #binding-cells = <2>;
            flavor = "balanced";
            tapping-term-ms = <280>;
            quick-tap-ms = <175>;
            // require-prior-idle-ms = <150>;
            bindings = <&kp>, <&kp>;
            hold-trigger-key-positions = <
                6 7 8 9 10 11
                18 19 20 21 22 23
                30 31 32 33 34 35
                36 37 38 39 40 41
            >;
            hold-trigger-on-release;
        };

        hmr: home_row_mod_right {
            compatible = "zmk,behavior-hold-tap";
            #binding-cells = <2>;
            flavor = "balanced";
            tapping-term-ms = <280>;
            quick-tap-ms = <175>;
            // require-prior-idle-ms = <150>;
            bindings = <&kp>, <&kp>;
            hold-trigger-key-positions = <
                0 1 2 3 4 5
                12 13 14 15 16 17
                24 25 26 27 28 29
                36 37 38 39 40 41
            >;
            hold-trigger-on-release;
        };
    };
};
